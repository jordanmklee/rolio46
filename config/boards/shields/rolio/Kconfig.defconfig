## config/boards/shields/rolio/Kconfig.defconfig
```kconfig
if SHIELD_ROLIO_LEFT

config ZMK_KEYBOARD_NAME
    default "Rolio"

config ZMK_SPLIT_ROLE_CENTRAL
    default y

endif

if SHIELD_ROLIO_LEFT || SHIELD_ROLIO_RIGHT

config ZMK_SPLIT
    default y

endif

if ZMK_BACKLIGHT

config PWM
    default y

config LED_PWM
    default y

endif # ZMK_BACKLIGHT

config ZMK_PM_SOFT_OFF
    bool "Soft-off support"
    depends on HAS_POWEROFF
    select ZMK_PM
    select PM_DEVICE
    select ZMK_PM_DEVICE_SUSPEND_RESUME
    select POWEROFF

config ZMK_GPIO_KEY_WAKEUP_TRIGGER
    bool "Hardware supported wakeup (GPIO)"
    default y
    depends on DT_HAS_ZMK_GPIO_KEY_WAKEUP_TRIGGER_ENABLED && ZMK_PM_SOFT_OFF
```

## config/west.yml
```yaml
manifest:
  remotes:
    - name: zmkfirmware
      url-base: https://github.com/zmkfirmware
    - name: tklzg
      url-base: https://github.com/tklzg
    - name: stephen
      url-base: https://github.com/stephen
    - name: m165437
      url-base: https://github.com/M165437
  projects:
    - name: zmk
      import: app/west.yml
      remote: zmkfirmware
      revision: main
    - name: nice-view-gem
      remote: m165437
      revision: main
  self:
    path: config
```
